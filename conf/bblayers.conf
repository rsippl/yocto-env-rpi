## conf/bblayers.conf
```bitbake
# POKY_BBLAYERS_CONF_VERSION is increased each time build/conf/bblayers.conf
# changes incompatibly
POKY_BBLAYERS_CONF_VERSION = "2"

BBPATH = "${TOPDIR}"
BBFILES ?= ""

BBLAYERS ?= " \
  /opt/yocto/workspace/layers/poky/meta \
  /opt/yocto/workspace/layers/poky/meta-poky \
  /opt/yocto/workspace/layers/poky/meta-yocto-bsp \

  /opt/yocto/workspace/layers/meta-openembedded/meta-oe \
  /opt/yocto/workspace/layers/meta-raspberrypi \
  "
```
